## package/aichat/Config.in
```kconfig
config BR2_PACKAGE_AICHAT
	bool "aichat"
	depends on BR2_PACKAGE_HOST_RUSTC_TARGET_ARCH_SUPPORTS
	depends on BR2_PACKAGE_HOST_RUSTC
	help
	  TBC

	  https://github.com/sigoden/aichat
```

## package/fish/Config.in
```kconfig
config BR2_PACKAGE_FISH
	bool "fish"
	depends on BR2_PACKAGE_HOST_RUSTC_TARGET_ARCH_SUPPORTS
	depends on BR2_PACKAGE_HOST_RUSTC
	help
	  fish - the friendly interactive shell.

	  fish includes features like syntax highlighting,
	  autosuggest-as-you-type, and fancy tab completions
	  that just work, with no configuration required.

	  https://fishshell.com/
```

## package/freescale-imx/imx-caam-keygen/Config.in
```kconfig
config BR2_PACKAGE_IMX_CAAM_KEYGEN
	bool "caam-keygen"
	depends on BR2_PACKAGE_FREESCALE_IMX_PLATFORM_IMX6UL
	help
	  The caam-keygen utility is used to operate with black keys
	  from user space. The app is strongly connected with the kernel
	  version and expects version 5.15 by default. It could be
	  buildable but not operable with other kernel versions.

	  https://github.com/nxp-imx/keyctl_caam
```

## package/helix/Config.in
```kconfig
config BR2_PACKAGE_HELIX
	bool "helix"
	depends on BR2_PACKAGE_HOST_RUSTC_TARGET_ARCH_SUPPORTS
	depends on BR2_PACKAGE_HOST_RUSTC
	help
	  A Kakoune / Neovim inspired editor, written in Rust.

	  Provides efficient navigation, a fuzzy finder for jumping to
	  files and symbols, multiple cursors, surround editing, theming
	  support, and more.

	  Most functionality is available out of the box with no
	  additional configuration.

	  https://helix-editor.com/

if BR2_PACKAGE_HELIX

config BR2_PACKAGE_HELIX_INSTALL_THEMES
	bool "install themes"
	default y
	help
	  Install color themes. This option adds about 1MB of data
	  to /usr/share/helix/runtime

config BR2_PACKAGE_HELIX_INSTALL_GRAMMARS
	bool "build grammars"
	default n
	help
	  Use this flag to build and install tree-sitter grammars.
	  This option adds about 200MB (all grammars) of data to
	  /usr/share/helix/runtime.

	  PLEASE NOTE: The process is currently unstable. Enable this
	  flag only if you intend to stabilize and improve the grammar
	  build process.
endif
```

## package/kibi/Config.in
```kconfig
config BR2_PACKAGE_KIBI
	bool "kibi"
	depends on BR2_PACKAGE_HOST_RUSTC_TARGET_ARCH_SUPPORTS
	select BR2_PACKAGE_HOST_RUSTC
	help
	  A configurable text editor with UTF-8 support, incremental
	  search, syntax highlighting, line numbers and more, written
	  in less than 1024 lines of Rust with minimal dependencies.

	  https://github.com/ilai-deutel/kibi
```

## package/nnn/Config.in
```kconfig
config BR2_PACKAGE_NNN
	bool "nnn"
	# Building nnn without widechar/UTF support is theoretically
	# possible, but in practice it leads to unstable builds.
	# That’s why the WCHAR dependency is here.
	depends on BR2_USE_WCHAR
	select BR2_PACKAGE_NCURSES
	select BR2_PACKAGE_NCURSES_WCHAR
	help
	  nnn is a lightweight yet powerful terminal file manager.
	  It is written in C, has minimal dependency, and works
	  out of the box.

	  https://github.com/jarun/nnn
```

## package/uutils-coreutils/Config.in
```kconfig
config BR2_PACKAGE_UUTILS_COREUTILS
	bool "uutils-coreutils"
	depends on BR2_PACKAGE_HOST_RUSTC_TARGET_ARCH_SUPPORTS
	depends on BR2_PACKAGE_HOST_RUSTC
	depends on BR2_PACKAGE_BUSYBOX_SHOW_OTHERS
	help
	  uutils is an attempt at writing universal (as in
	  cross-platform) CLI utilities in Rust. While all programs have
	  been implemented, some options might be missing or different
	  behavior might be experienced.

	  https://github.com/uutils/coreutils

if BR2_PACKAGE_UUTILS_COREUTILS

config BR2_PACKAGE_UUTILS_COREUTILS_MULTICALL
	bool "multicall"
	default y
	help
	  Build coreutils as a multi-call binary.

	  Selecting 'y' will build and install a single
	  'coreutils' binary that supports all commands.

	  Selecting 'n' will build and install the utilities
	  as separate files.

endif
```
