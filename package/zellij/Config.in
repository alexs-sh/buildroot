## package/zellij/Config.in
```kconfig
config BR2_PACKAGE_ZELLIJ
	bool "zellij"
	depends on BR2_PACKAGE_HOST_RUSTC_TARGET_ARCH_SUPPORTS
	# zellij unconditionally uses AtomicU64
	depends on BR2_PACKAGE_HOST_RUSTC_TARGET_HAS_ATOMIC_U64
	select BR2_PACKAGE_HOST_RUSTC
	help
	  An advanced terminal multiplexer with batteries included.
	  Supports layouts, floating and stacked panes, plugins, and
	  customization. Provides rich functionality out of the box.

	  Zellij is aimed at developers, operations-oriented users,
	  and anyone who loves the terminal.

	  https://github.com/zellij-org/zellij
```
